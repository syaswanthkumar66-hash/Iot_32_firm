## main/Kconfig.projbuild
```kconfig
menu "IoTyk Relay Firmware Configuration"

    config IOTYK_TESTING_MODE
        bool "Enable Testing Mode (serial debug, export credentials)"
        default y
        help
            When enabled, serial commands and credential export are available.
            Disable for production.

    config IOTYK_WIFI_SSID
        string "WiFi SSID"
        default ""
        help
            WiFi network name.

    config IOTYK_WIFI_PASSWORD
        string "WiFi Password"
        default ""
        help
            WiFi password.

    config IOTYK_MQTT_BROKER_URI
        string "MQTT Broker URI"
        default "mqtts://test.mosquitto.org"
        help
            MQTT broker address with protocol.

    config IOTYK_OTA_FIRMWARE_URL
        string "OTA Firmware URL"
        default "https://example.com/iotyk_fw.bin"
        help
            URL for OTA firmware download.

endmenu
```

## sdkconfig.defaults
```kconfig
# Security - Development Mode (Reflashable)
CONFIG_SECURE_BOOT_V2_ENABLED=n
CONFIG_SECURE_FLASH_ENC_ENABLED=n
CONFIG_SECURE_BOOT_ALLOW_JTAG=y
CONFIG_SECURE_BOOT_ALLOW_ROM_BASIC=y

# Performance
CONFIG_ESP32_DEFAULT_CPU_FREQ_240=y
CONFIG_FREERTOS_HZ=1000
CONFIG_ESP_WIFI_STATIC_RX_BUFFER_NUM=16
CONFIG_ESP_WIFI_DYNAMIC_RX_BUFFER_NUM=32
CONFIG_ESP_WIFI_DYNAMIC_TX_BUFFER_NUM=32
CONFIG_LWIP_MAX_SOCKETS=16

# Hardware Crypto (Still use hardware acceleration)
CONFIG_MBEDTLS_HARDWARE_AES=y
CONFIG_MBEDTLS_HARDWARE_SHA=y

# NVS Encryption (Software-based for testing)
CONFIG_NVS_ENCRYPTION=y

# OTA (Counter in NVS, not eFuse)
CONFIG_BOOTLOADER_APP_ROLLBACK_ENABLE=n

# Debug Features (ENABLED for testing)
CONFIG_ESP_SYSTEM_PANIC_PRINT_HALT=y
CONFIG_ESP_DEBUG_OCDAWARE=y
CONFIG_FREERTOS_WATCHPOINT_END_OF_STACK=y

# WiFi
CONFIG_ESP_WIFI_STA_DISCONNECTED_PM_ENABLE=n
CONFIG_ESP_WIFI_PM_ENABLE=n

# MQTT
CONFIG_MQTT_TRANSPORT_SSL=y
CONFIG_MQTT_TRANSPORT_WEBSOCKET=n

# cbor
CONFIG_TINYCBOR=y
```
